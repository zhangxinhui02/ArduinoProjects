#include <UTFT.h>


UTFT myGLCD(YYROBOT_TFT144,A2,A1,A5,A4,A3);  // Remember to change the model parameter to suit your display module!
//YYROBOT_TFT144  屏幕型号，不用修改
//SDA----A2
//SCL----A1
//CS-----A5
//RST----A4
//RS----A3
//LED---A0  UTFT库里面设定的，如果需要修改需要修改库文件

extern uint8_t SmallFont[];//原始文件在库文件的DefaultFonts.c中
extern uint8_t BigFont[];//原始文件在库文件的DefaultFonts.c中
extern uint8_t SevenSegNumFont[];//原始文件在库文件的DefaultFonts.c中
const uint8_t tfont16[] =
{

0x04,0x01,0x04,0x01,0x04,0x02,0x04,0x04,0x04,0x08,0x04,0x30,0x04,0xC0,0xFF,0x00,
0x04,0xC0,0x04,0x30,0x04,0x08,0x04,0x04,0x04,0x02,0x04,0x01,0x04,0x01,0x00,0x00,/*"大",0*/
0x02,0x20,0x0C,0x20,0x88,0x20,0x69,0x20,0x09,0x20,0x09,0x22,0x89,0x21,0x69,0x7E,
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0x24,0x90,0xFF,0xFE,0x24,0x90,0x24,0x92,0xA4,0x91,0x67,0xFE,0x20,0x00,0x00,0x00,/*"铺",6*/


};

void setup()
{
  randomSeed(analogRead(0));
// Setup the LCD
  myGLCD.InitLCD();//初始化液晶
  myGLCD.InitLCD();//初始化两次有利于系统稳定
  myGLCD.setFont(SmallFont);//设置字体为SmallFont格式
}
void loop()
{

  
  myGLCD.fillScr(255,0,0);//填充RED
  delay (500);
  myGLCD.fillScr(0,255,0);//填充GREEN
  delay (500);
  myGLCD.fillScr(0,0,255);//填充BLUE
  delay (500);
  
  //En_8X12 Test
  myGLCD.setColor(255, 255, 255);//设置字体颜色
  myGLCD.setBackColor(255, 0, 0);//设置背景颜色
  myGLCD.clrScr(); //清屏
  myGLCD.setFont(SmallFont);//设置字体为SmallFont格式(8*12字符)
  myGLCD.print("HelloWorld", CENTER, 20);  //打印HelloWorld，中间显示，显示在20行  
  myGLCD.setFont(BigFont); //设置大字体BigFont（16*16字符）
  myGLCD.print("YYROBOT", LEFT, 40);  //打印YYROBOT，靠左显示，显示在20行  
  delay (500);
  
  
  //myGLCD.setFont(BigFont);
  myGLCD.setFont(SmallFont);
  myGLCD.clrScr(); 
  myGLCD.print("Size:1.44", LEFT, 20);   
  myGLCD.print("Dots:128X128", LEFT, 35);
  myGLCD.print("Driver:ST7735", LEFT, 50);
  myGLCD.print("ilovemcu.taobao", LEFT, 65);  
  myGLCD.print(".com", RIGHT, 80);  
  delay (3000);
  
  
  //SegNum Test
  myGLCD.setColor(255, 255, 255);
  myGLCD.setBackColor(255, 0, 0);
   myGLCD.clrScr(); 
  myGLCD.setFont(SmallFont);
  myGLCD.print("SegNum Test", CENTER, 20);   
  delay (500);
  myGLCD.setFont(SevenSegNumFont);
  for(int i=100;i<110;i++)
  {    
    myGLCD.printNumI(i, 0, 50, 4, '0');//显示数值是i，位置x=0，y=50，长度4，空位置填充字符0
    delay (500);
  }

  
  
   //ChineseFont Test 16*16自定义汉字测试
  myGLCD.clrScr(); 
  myGLCD.setFont(SmallFont);
  myGLCD.print("Cn_16X16 Test", CENTER, 20);   
  delay (500);
  Show_CH_Font16(0,50,0);
  Show_CH_Font16(16,50,1);
  Show_CH_Font16(32,50,2);
  Show_CH_Font16(48,50,3);
  Show_CH_Font16(64,50,4);
  Show_CH_Font16(80,50,5);
  Show_CH_Font16(96,50,6);
  delay (2000);
  while(1);
}


void Show_CH_Font16(int x,int y,int FontPos)
{
        char temp,t,t1,k;
  int y0=y; 
  int HZnum;

        for(t=0;t<32;t++)//每个16*16的汉字点阵 有32个字节
  {   
    temp=tfont16[t+32*FontPos];                    
    for(t1=0;t1<8;t1++)
    {
        if(temp&0x80)
              { 
                myGLCD.setColor(255, 0, 0);//FontColor
                myGLCD.drawPixel(x,y);
              }
        else 
              { 
                myGLCD.setColor(0, 0, 0);//BackColor
                myGLCD.drawPixel(x,y);
              }

        temp<<=1;
        y++;
        if((y-y0)==16)
        {
    y=y0;
    x++;
    break;
        }
       
    }    
  }   


}
