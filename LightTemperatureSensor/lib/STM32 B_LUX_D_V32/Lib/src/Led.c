#include "Led.h"

/*---------------------------------------------------------------------
功能描述：LED引脚初始化函数
参数说明：无
函数返回：无
 ---------------------------------------------------------------------*/
void Led_Init(void)
{
	RCC->AHB1ENR |= (0x01<<6);			//使能GPIOG的 AHB时钟

	GPIOG->MODER 	&= ~(0x03<<26); 
	GPIOG->PUPDR 	&= ~(0x03<<26);
	
	GPIOG->MODER 	&= ~(0x03<<28); 
	GPIOG->PUPDR 	&= ~(0x03<<28);
	
	GLED_O;
	RLED_O;
}

/*---------------------------------------------------------------------
功能描述：LED开启函数
参数说明：vSel[in] - 引脚选择 
函数返回：无
 ---------------------------------------------------------------------*/
void Set_LedOn(uint8 vSel)
{
	if (vSel == Gled)
	{
		GLED_H;
	}
	else if (vSel == Rled)
	{
		RLED_H;
	}
}

/*---------------------------------------------------------------------
功能描述：LED关闭
参数说明：vSel[in] - 引脚选择 
函数返回：无
 ---------------------------------------------------------------------*/
void Set_LedOff(uint8 vSel)
{
	if (vSel == Gled)
	{
		GLED_L;
	}
	else if (vSel == Rled)
	{
		RLED_L;
	}
	
}

/*---------------------------------------------------------------------
功能描述：LED 开关颠倒切换
参数说明：vSel[in] - 引脚选择
函数返回：无
 ---------------------------------------------------------------------*/
void Set_LedTranspose(uint8 vSel)
{
	uint8 vsl = 0;
	vsl = vSel;
	if (vsl == Gled)
	{
		if (GLED_DAT)
		{
			GLED_L;
		}
		else
		{
			GLED_H;
		}
	}
	else if (vsl == Rled)
	{
		if (RLED_DAT)
		{			
			RLED_L;
		}
		else
		{
			RLED_H;
		}
	}
}

